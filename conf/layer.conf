## conf/layer.conf
```bitbake
# We have a conf and classes directory, add to BBPATH
BBPATH .= ":${LAYERDIR}"

# We have recipes-* directories, add to BBFILES
BBFILES += "${LAYERDIR}/recipes-*/*/*.bb \
            ${LAYERDIR}/recipes-*/*/*.bbappend"

BBFILE_COLLECTIONS += "meta-mangupt-demo"
BBFILE_PATTERN_meta-mangupt-demo = "^${LAYERDIR}/"
BBFILE_PRIORITY_meta-mangupt-demo = "6"

LAYERDEPENDS_meta-mangupt-demo = "core"
LAYERSERIES_COMPAT_meta-mangupt-demo = "kirkstone"
```
